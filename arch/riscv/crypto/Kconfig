## arch/riscv/crypto/Kconfig
```kconfig
# SPDX-License-Identifier: GPL-2.0

menu "Accelerated Cryptographic Algorithms for CPU (riscv)"

config CRYPTO_AES_RISCV64
	default y if RISCV_ISA_V
	tristate "Ciphers: AES"
	depends on 64BIT && RISCV_ISA_V
	select CRYPTO_AES
	select CRYPTO_ALGAPI
	help
	  Block ciphers: AES cipher algorithms (FIPS-197)

	  Architecture: riscv64 using:
	  - Zvkned vector crypto extension

config CRYPTO_AES_BLOCK_RISCV64
	default y if RISCV_ISA_V
	tristate "Ciphers: AES, modes: ECB/CBC/CTR/XTS"
	depends on 64BIT && RISCV_ISA_V
	select CRYPTO_AES_RISCV64
	select CRYPTO_SKCIPHER
	help
	  Length-preserving ciphers: AES cipher algorithms (FIPS-197)
	  with block cipher modes:
	  - ECB (Electronic Codebook) mode (NIST SP 800-38A)
	  - CBC (Cipher Block Chaining) mode (NIST SP 800-38A)
	  - CTR (Counter) mode (NIST SP 800-38A)
	  - XTS (XOR Encrypt XOR Tweakable Block Cipher with Ciphertext
	    Stealing) mode (NIST SP 800-38E and IEEE 1619)

	  Architecture: riscv64 using:
	  - Zvbb vector extension (XTS)
	  - Zvkb vector crypto extension (CTR/XTS)
	  - Zvkg vector crypto extension (XTS)
	  - Zvkned vector crypto extension

endmenu
```
